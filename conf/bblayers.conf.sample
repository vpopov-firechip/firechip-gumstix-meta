## conf/bblayers.conf.sample
```bitbake
# LAYER_CONF_VERSION is increased each time build/conf/bblayers.conf
# changes incompatibly
LCONF_VERSION = "6"

BBPATH = "${TOPDIR}"
BBFILES ?= ""
BBLAYERS ?= " \
  ##COREBASE##/meta \
  ##COREBASE##/meta-poky \
  ##COREBASE##/meta-yocto-bsp \
  ##COREBASE##/meta-ti \
  ##COREBASE##/meta-raspberrypi \
  ##COREBASE##/meta-openembedded/meta-oe \
  ##COREBASE##/meta-openembedded/meta-python \
  ##COREBASE##/meta-openembedded/meta-networking \
  ##COREBASE##/meta-openembedded/meta-multimedia \
  ##COREBASE##/meta-gumstix \
  ##COREBASE##/meta-gumstix-extras \
  ##COREBASE##/meta-java \
  ##COREBASE##/meta-clang \
  ##COREBASE##/meta-gumstix-firechip \
  "
```

## conf/layer.conf
```bitbake
# We have a conf and classes directory, add to BBPATH
BBPATH .= ":${LAYERDIR}"

# We have recipes-* directories, add to BBFILES
BBFILES += "${LAYERDIR}/recipes-*/*/*.bb \
            ${LAYERDIR}/recipes-*/*/*.bbappend"

BBFILE_COLLECTIONS += "meta-gumstix-firechip"
BBFILE_PATTERN_meta-gumstix-firechip = "^${LAYERDIR}/"
BBFILE_PRIORITY_meta-gumstix-firechip = "6"

LAYERDEPENDS_meta-gumstix-firechip = "core"
LAYERSERIES_COMPAT_meta-gumstix-firechip = "warrior"
```
